## CMakeLists.txt
```
cmake_minimum_required(VERSION 3.13.1)

if(NOT DEFINED BOARD)
    set(BOARD steering_wheel CACHE STRING "Zephyr target board")
    message(STATUS "BOARD not defined externally, using default: ${BOARD}")
endif()

if(NOT DEFINED BOARD_ROOT)
    set(BOARD_ROOT ${CMAKE_CURRENT_SOURCE_DIR}/../ CACHE PATH "Root directory for custom boards")
    message(STATUS "BOARD_ROOT not defined externally, using default: ${BOARD_ROOT}")
endif()

find_package(Zephyr REQUIRED HINTS $ENV{ZEPHYR_BASE})
project(app LANGUAGES C)

target_sources(app PRIVATE
        src/main.c
        src/steering_wheel.c
        peripherals/can.c
        peripherals/gpio.c
        peripherals/adc.c
        peripherals/pwm.c
        peripherals/counter.c
)

target_include_directories(app PRIVATE
        peripherals
        lib-can-definitions
        src
)
```

## prj.conf
```kconfig
CONFIG_GPIO=y

CONFIG_CONSOLE=y
CONFIG_UART_CONSOLE=y

CONFIG_LOG=y
CONFIG_LOG_DEFAULT_LEVEL=4
CONFIG_LOG_PRINTK=y


CONFIG_SERIAL=y

CONFIG_MAIN_STACK_SIZE=2048

CONFIG_NEWLIB_LIBC=y
CONFIG_PICOLIBC=n

CONFIG_LOG_BACKEND_SWO=y
CONFIG_LOG_BUFFER_SIZE=2048
CONFIG_LOG_MODE_DEFERRED=y
CONFIG_LOG_BACKEND_UART=n
CONFIG_PRINTK=y
CONFIG_STDOUT_CONSOLE=y
```

## example_steering_wheel.overlay
```dts
//#include <zephyr/dt-bindings/gpio/gpio.h>
//#include <zephyr/dt-bindings/led/led.h>
//
/// {
//	led_strip: ws2812 {
//		compatible = "worldsemi,ws2812-gpio";
//
//		chain-length = <16>; /* arbitrary */
//		color-mapping = <LED_COLOR_ID_GREEN
//						 LED_COLOR_ID_RED
//						 LED_COLOR_ID_BLUE>;
//
//		gpios = <&gpio0 8 0>;
//		prop-req = <0>;
//	};
//
//	aliases {
//		led-strip = &led_strip;
//	};
//};
```

## src/main.c
```c
// #include <zephyr/kernel.h>
// #include <zephyr/drivers/gpio.h>
// #include <zephyr/drivers/adc.h>
// #include <zephyr/devicetree.h>
// #include <stdio.h> // Include for printk
// #include <zephyr/logging/log.h>
//
// #if !DT_NODE_HAS_STATUS(DT_ALIAS(ledgreen), okay)
// #error "No LED node has been configured"
// #endif
//
// // #if !DT_NODE_HAS_STATUS(DT_ALIAS(button), okay)
// // #error "No button node has been configured"
// // #endif
//
// // #if !DT_NODE_EXISTS(DT_PATH(zephyr_user)) || !DT_NODE_HAS_PROP(DT_PATH(zephyr_user), io_channels)
// // #error "No ADC I/O node has been configured"
// // #endif
//
// #define SLEEP_TIME_MS 1000
//
// LOG_MODULE_REGISTER(app);
//
// static const struct gpio_dt_spec led = GPIO_DT_SPEC_GET(DT_ALIAS(ledgreen), gpios);
// // static const struct gpio_dt_spec button = GPIO_DT_SPEC_GET(DT_ALIAS(button), gpios);
// // static const struct adc_dt_spec adc_channel_idx0 = ADC_DT_SPEC_GET_BY_IDX(DT_PATH(zephyr_user), 0);
//
// // static struct gpio_callback button_cb_data;
//
// // uint16_t adc_sample;
// // struct adc_sequence adc_sequence = {
// //     .buffer = &adc_sample,
// //     .buffer_size = sizeof(adc_sample), /* buffer size in bytes, not number of samples */
// // };
//
// int led_initialize() {
//     if (!device_is_ready(led.port)) {
//         // Use device_is_ready for driver check
//         printk("Error: GPIO device %s is not ready\n", led.port->name);
//         return 1; // Indicate error
//     } else {
//         printk("GPIO device %s is ready\n", led.port->name);
//     }
//
//     int ret = gpio_pin_configure_dt(&led, GPIO_OUTPUT_ACTIVE);
//     if (ret < 0) {
//         printk("Error %d: failed to configure LED pin %d\n", ret, led.pin);
//         return 1; // Indicate error
//     } else {
//         printk("Successfully configured LED pin %d\n", led.pin);
//     }
//
//     return ret;
// }
//
// int led_on_tick() {
//     int ret = gpio_pin_toggle_dt(&led);
//     printk("[LED] Toggled LED. Return code: %d\n", ret);
//     if (ret < 0) {
//         printk("Error %d: failed to toggle LED pin %d\n", ret, led.pin);
//     }
//     return ret;
// }
//
// // void button_on_key_pressed(const struct device *dev, struct gpio_callback *cb, uint32_t pins) {
// //     printk("[BTN] Button pressed at %" PRIu32 "\n", k_cycle_get_32());
// //     gpio_pin_toggle_dt(&led);
// // }
//
// // int button_initialize() {
// //     int ret;
// //
// //     if (!gpio_is_ready_dt(&button)) {
// //         printk("Error: button device %s is not ready\n",
// //                button.port->name);
// //         return 0;
// //     }
// //
// //     ret = gpio_pin_configure_dt(&button, GPIO_INPUT);
// //     if (ret != 0) {
// //         printk("Error %d: failed to configure %s pin %d\n",
// //                ret, button.port->name, button.pin);
// //         return 0;
// //     }
// //
// //     ret = gpio_pin_interrupt_configure_dt(&button,
// //                                           GPIO_INT_EDGE_TO_ACTIVE);
// //     if (ret != 0) {
// //         printk("Error %d: failed to configure interrupt on %s pin %d\n",
// //                ret, button.port->name, button.pin);
// //         return 0;
// //     }
// //
// //     gpio_init_callback(&button_cb_data, button_on_key_pressed, BIT(button.pin));
// //     gpio_add_callback(button.port, &button_cb_data);
// //     printk("Set up button at %s pin %d\n", button.port->name, button.pin);
// //
// //     return ret;
// // }
//
// // int adc_initialize() {
// //     if (!adc_is_ready_dt(&adc_channel_idx0)) {
// //         printk("ADC controller device %s not ready\n", adc_channel_idx0.dev->name);
// //         return 0;
// //     }
// //
// //     int ret = adc_channel_setup_dt(&adc_channel_idx0);
// //     if (ret < 0) {
// //         printk("Could not setup channel #%d (%d)\n", 0, ret);
// //         return 0;
// //     }
// //
// //     return ret;
// // }
// //
// // int adc_on_tick() {
// //     printk("[ADC] %s, channel %d: ",
// //            adc_channel_idx0.dev->name,
// //            adc_channel_idx0.channel_id);
// //
// //     adc_sequence_init_dt(&adc_channel_idx0, &adc_sequence);
// //
// //     int ret = adc_read_dt(&adc_channel_idx0, &adc_sequence);
// //     if (ret < 0) {
// //         printk("Could not read (%d)\n", ret);
// //         return ret;
// //     }
// //
// //     printk("%"PRId32"\n", (int32_t) adc_sample);
// //
// //     return ret;
// // }
//
// int main() {
//     printk("Starting program on board: %s\n", CONFIG_BOARD);
//
//     if (led_initialize()!= 0) {
//         printk("LED init failed!\n");
//         return -1;
//     }
//     //button_initialize();
//     //adc_initialize();
//
//     printk("Entering blink loop...\n");
//     while (1) {
//         led_on_tick();
//         // LOG_INF("System started\n");
//         //adc_on_tick();
//         // printf("dupa\n");
//         // printk("Loop\n");
//         k_msleep(1000);
//     }
//     return 0;
// }
#include <errno.h>
#include <string.h>

#define LOG_LEVEL 4
#include <zephyr/logging/log.h>
LOG_MODULE_REGISTER(main);

#include <zephyr/kernel.h>
#include <zephyr/drivers/led_strip.h>
#include <zephyr/device.h>
#include <zephyr/drivers/spi.h>
#include <zephyr/sys/util.h>

#define STRIP_NODE		DT_ALIAS(led_strip)

#define SAMPLE_LED_UPDATE_DELAY 10

#define SAMPLE_LED_BRIGHTNESS 0xFF

#define STRIP_NUM_PIXELS	DT_PROP(DT_ALIAS(led_strip), chain_length)


#define DELAY_TIME K_MSEC(SAMPLE_LED_UPDATE_DELAY)

#define RGB(_r, _g, _b) { .r = (_r), .g = (_g), .b = (_b) }

static const struct led_rgb colors[] = {
    RGB(SAMPLE_LED_BRIGHTNESS, 0x00, 0x00), /* red */
    RGB(0x00, SAMPLE_LED_BRIGHTNESS, 0x00), /* green */
    RGB(0x00, 0x00, SAMPLE_LED_BRIGHTNESS), /* blue */
};

static struct led_rgb pixels[STRIP_NUM_PIXELS];

static const struct device *const strip = DEVICE_DT_GET(STRIP_NODE);

int main(void)
{
    size_t color = 0;
    int rc;

    if (device_is_ready(strip)) {
        LOG_INF("Found LED strip device %s", strip->name);
    } else {
        LOG_ERR("LED strip device %s is not ready", strip->name);
        return 0;
    }

    LOG_INF("Displaying pattern on strip");
    while (1) {
        for (size_t cursor = 0; cursor < ARRAY_SIZE(pixels); cursor++) {
            memset(&pixels, 0x00, sizeof(pixels));
            memcpy(&pixels[cursor], &colors[color], sizeof(struct led_rgb));

            rc = led_strip_update_rgb(strip, pixels, STRIP_NUM_PIXELS);
            if (rc) {
                LOG_ERR("couldn't update strip: %d", rc);
            }

            k_sleep(DELAY_TIME);
        }

        color = (color + 1) % ARRAY_SIZE(colors);
    }

    return 0;
}
```

## src/steering_wheel.c
```c
//
// Created by User on 28.12.2025.
//

#include "steering_wheel.h"

LOG_MODULE_REGISTER(steering_wheel_unit);

static uint8_t lights_buttons_mask;
static bool send_pending;

static lights_button_t lights_buttons[] = {
    { .gpio = GPIO_DT_SPEC_GET(DT_ALIAS(button_lights_hazard), gpios),
      .light_bit = LIGHT_HAZARD },
    { .gpio = GPIO_DT_SPEC_GET(DT_ALIAS(button_lights_beam), gpios),
      .light_bit = LIGHT_BEAM},
    { .gpio = GPIO_DT_SPEC_GET(DT_ALIAS(button_lights_position), gpios),
      .light_bit = LIGHT_POSITION },
    { .gpio = GPIO_DT_SPEC_GET(DT_ALIAS(button_lights_right_indicator), gpios),
      .light_bit = LIGHT_RIGHT_INDICATOR },
    { .gpio = GPIO_DT_SPEC_GET(DT_ALIAS(button_lights_left_indicator), gpios),
      .light_bit = LIGHT_LEFT_INDICATOR },
};

struct can_filter swu_filter[] = {
{.flags = 0U,
  .id = CAN_ID_SENSOR_SPEED,
  .mask = CAN_STD_ID_MASK
    },
{.flags = 0U,
   .id = CAN_ID_SC_VOLTAGE,
   .mask = CAN_STD_ID_MASK
    },
};

swu_can_t can = {
    .can_device = DEVICE_DT_GET(DT_ALIAS(can)),
    .can_rx_led = GPIO_DT_SPEC_GET(DT_ALIAS(can_rx_led), gpios),
};

static void lights_button_isr(const struct device *dev,
                       struct gpio_callback *cb,
                       uint32_t pins)
{
    lights_button_t *btn =
        CONTAINER_OF(cb, lights_button_t, cb);

    k_work_reschedule(&btn->work, K_MSEC(DEBOUNCE_MS));
}

static void lights_button_work_handler(struct k_work *work)
{
    struct k_work_delayable *dwork =
        k_work_delayable_from_work(work);

    lights_button_t *btn =
        CONTAINER_OF(dwork, lights_button_t, work);

    int val = gpio_pin_get_dt(&btn->gpio);

    if (val != btn->stable_state) {
        btn->stable_state = val;

        if (val) {
            lights_buttons_mask |= BIT(btn->light_bit);
        } else {
            lights_buttons_mask &= ~BIT(btn->light_bit);
        }

        send_pending = true;
    }
}

static void lights_buttons_init()
{
    for (int i = 0; i < ARRAY_SIZE(lights_buttons); i++) {
        lights_button_t *btn = &lights_buttons[i];

        gpio_init(&btn->gpio, GPIO_INPUT);

        gpio_set_interrupt(&btn->gpio, GPIO_INT_EDGE_BOTH, &btn->cb,  lights_button_isr);

        btn->stable_state = gpio_pin_get_dt(&btn->gpio);

        k_work_init_delayable(&btn->work, lights_button_work_handler);
    }
}

void lcu_can_rx_callback(const struct device *dev, struct can_frame *frame, void *user_data) {
    if ((frame -> id) == 0x11) {
        printf("Odebrano: %u\n", frame->data[0]);

    }
}


static void swu_can_init() {
    can_init(can.can_device, HYDROGREEN_CAN_BAUD_RATE);

    for (int i = 0; i < ARRAY_SIZE(swu_filter); i++) {
        can_add_rx_filter_(can.can_device, lcu_can_rx_callback, &swu_filter[i]);
    }
}

static void system_timer_handler(struct k_timer *timer)
{
    ARG_UNUSED(timer);

    for (int i = 0; i < ARRAY_SIZE(lights_buttons); i++) {
        k_work_submit(&lights_buttons[i].work.work);
    }
    send_pending = true;
}

K_TIMER_DEFINE(system_timer, system_timer_handler, NULL);

void steering_wheel_init() {
    lights_buttons_init();
    swu_can_init();

    k_timer_start(&system_timer,
              K_MSEC(CHECK_LIGHTS_BUTTONS_MS),
              K_MSEC(CHECK_LIGHTS_BUTTONS_MS));


}

void can_tx_thread(void)
{
    while (1) {
        if (send_pending) {
            send_pending = false;
            can_send_(can.can_device, CAN_ID_BUTTONS_LIGHTS_MASK, &lights_buttons_mask, sizeof(lights_buttons_mask) );
        }
        k_sleep(K_MSEC(10));
    }
}
```

## src/steering_wheel.h
```c
//
// Created by User on 28.12.2025.
//

#ifndef STEERING_WHEEL_H
#define STEERING_WHEEL_H

#include <stdint.h>
#include <zephyr/kernel.h>
#include <zephyr/device.h>
#include <zephyr/logging/log.h>
#include "gpio.h"
#include "can.h"
#include "can_ids.h"

#define DEBOUNCE_MS    20
#define CHECK_LIGHTS_BUTTONS_MS 100

typedef enum {
    ON  = 0,
    OFF = 1,
} button_state_t;

typedef enum {
    LIGHT_HAZARD             = 0,
    LIGHT_BEAM               = 1,
    LIGHT_POSITION           = 2,
    LIGHT_RIGHT_INDICATOR    = 3,
    LIGHT_LEFT_INDICATOR     = 4,
} light_bit_t;

typedef struct {
    struct gpio_dt_spec gpio;
    struct gpio_callback cb;
    struct k_work_delayable work;

    uint8_t stable_state;
    uint8_t light_bit;
}lights_button_t;

typedef struct {
    const struct device *can_device;
    struct gpio_dt_spec can_tx_led;
    struct gpio_dt_spec can_rx_led;
}swu_can_t;

void steering_wheel_init();

#endif //STEERING_WHEEL_H
```
